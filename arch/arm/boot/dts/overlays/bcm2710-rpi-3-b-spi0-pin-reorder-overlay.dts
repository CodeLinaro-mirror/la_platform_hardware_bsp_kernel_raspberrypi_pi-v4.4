/dts-v1/;
/plugin/;

/{
  fragment@0 {
    target = <&spi0_cs_pins>;
    __overlay__ {
      brcm,pins = <7 8>;
    };
  };

  fragment@1 {
    target = <&spi0>;
    __overlay__ {
      pinctrl-0 = <&spi0_cs_pins &spi0_pins>;
    };
  };
};
